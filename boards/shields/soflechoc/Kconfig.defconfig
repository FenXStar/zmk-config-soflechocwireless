## boards/shields/soflechoc/Kconfig.defconfig
```kconfig
if SHIELD_SOFLECHOC_LEFT

config ZMK_KEYBOARD_NAME
	default "Sofle Choc"

endif

if SHIELD_SOFLECHOC_LEFT || SHIELD_SOFLECHOC_RIGHT

config ZMK_SPLIT
	default y

if ZMK_DISPLAY

config I2C
	default y

config SSD1306
	default y

choice ZMK_DISPLAY_WORK_QUEUE
	default ZMK_DISPLAY_WORK_QUEUE_DEDICATED
endchoice

endif # ZMK_DISPLAY

if LVGL

config LV_Z_VDB_SIZE
	default 64

config LV_DPI_DEF
	default 148

config LV_Z_BITS_PER_PIXEL
	default 1

choice LV_COLOR_DEPTH
	default LV_COLOR_DEPTH_1
endchoice

endif # LVGL

endif

if SHIELD_SOFLECHOC_DONGLE

config ZMK_KEYBOARD_NAME
	default "Sofle Choc"

config ZMK_SPLIT_ROLE_CENTRAL
	default y

config ZMK_SPLIT
	default y

config ZMK_SPLIT_BLE_CENTRAL_PERIPHERALS
	default 2

endif
```

## boards/shields/soflechoc/Kconfig.shield
```kconfig
config SHIELD_SOFLECHOC_LEFT
	def_bool $(shields_list_contains,soflechoc_left)

config SHIELD_SOFLECHOC_RIGHT
	def_bool $(shields_list_contains,soflechoc_right)

config SHIELD_SOFLECHOC_DONGLE
	def_bool $(shields_list_contains,soflechoc_dongle)
```

## config/boards/shields/sofle_dongle/Kconfig.shield
```kconfig
config SHIELD_SOFLE_DONGLE_LEFT
    def_bool $(shields_list_contains,sofle_dongle_left)

config SHIELD_SOFLE_DONGLE_RIGHT
    def_bool $(shields_list_contains,sofle_dongle_right)
```
